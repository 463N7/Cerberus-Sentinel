## expansion/c5_scanner/sdkconfig.defaults
```kconfig
CONFIG_IDF_TARGET="esp32c5"

# Keep fresh builds aligned with the runtime used by released C5 firmware 1.
CONFIG_COMPILER_ASSERT_NDEBUG_EVALUATE=y
CONFIG_COMPILER_DISABLE_DEFAULT_ERRORS=y
CONFIG_COMPILER_ORPHAN_SECTIONS_ERROR=n
CONFIG_COMPILER_ORPHAN_SECTIONS_WARNING=y
CONFIG_LIBC_NEWLIB=y
CONFIG_LIBC_PICOLIBC=n
CONFIG_FREERTOS_IN_IRAM=y
CONFIG_MBEDTLS_THREADING_C=n
CONFIG_MBEDTLS_SSL_KEEP_PEER_CERTIFICATE=y
CONFIG_MBEDTLS_LARGE_KEY_SOFTWARE_MPI=n
CONFIG_ESP_PROTOCOMM_SUPPORT_SECURITY_VERSION_0=y
CONFIG_ESP_PROTOCOMM_SUPPORT_SECURITY_VERSION_1=y
CONFIG_VFS_SUPPORT_TERMIOS=y
```
